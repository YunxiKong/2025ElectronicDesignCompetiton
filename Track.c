#include "stm32f10x.h"                  // Device header
#include "Motor.h"
#include "sensor.h"
#include "Delay.h"

unsigned char lukou_num = 0; //全局变量定义检测到路口的次数

/*************************************
*函数名称：track_zhixian1()
*函数功能：直线循迹
*白底黑线，线宽2厘米，其他线宽根据实际情况改写。
**************************************/
void track_zhixian()
{    
	unsigned char num = 0,i;  //num个灯压线认为是到达路口
	
	for(i=0;i<2;i++) //循环检测路口2次
	{
		if(D1 == 1)num++;	
		if(D2 == 1)num++;	
		if(D3 == 1)num++;	
		if(D4 == 1)num++;
		if(D5 == 1)num++;	
		if(D6 == 1)num++;	
		if(D7 == 1)num++;	
		if(D8 == 1)num++;
		
		if(num >= (8-4)) //大于等于n-4个灯压线认为是到达路口
		{ 
			lukou_num++; 
			if(lukou_num == 1)	 Delay_ms(10); //第一次检测到延时10ms，消抖操作
		}  
		num = 0;
	}
	if(lukou_num >= 2) { lukou_num = 0; motor(0,0); Delay_ms(1000);Delay_ms(1000);}  //检测2次都是路口后才认为是真正到达路口，防止误判
	
	//这里的逻辑是1路在小车的左边，N路在小车的右边
    //8765 4321（路）
	if((D1 == 1)&&(D2 == 0)&&(D3 == 0)&&(D4 == 0)&&(D5 == 0)&&(D6 == 0)&&(D7 == 0)&&(D8 == 0))        motor(0,50);      //0000 0001
	else if((D1 == 1)&&(D2 == 1)&&(D3 == 0)&&(D4 == 0)&&(D5 == 0)&&(D6 == 0)&&(D7 == 0)&&(D8 == 0))   motor(10,50);     //0000 0011
	else if((D1 == 0)&&(D2 == 1)&&(D3 == 0)&&(D4 == 0)&&(D5 == 0)&&(D6 == 0)&&(D7 == 0)&&(D8 == 0))   motor(15,40);     //0000 0010
	else if((D1 == 0)&&(D2 == 1)&&(D3 == 1)&&(D4 == 0)&&(D5 == 0)&&(D6 == 0)&&(D7 == 0)&&(D8 == 0))   motor(20,40);     //0000 0110
	else if((D1 == 0)&&(D2 == 0)&&(D3 == 1)&&(D4 == 0)&&(D5 == 0)&&(D6 == 0)&&(D7 == 0)&&(D8 == 0))   motor(25,40);     //0000 0100
	else if((D1 == 0)&&(D2 == 0)&&(D3 == 1)&&(D4 == 1)&&(D5 == 0)&&(D6 == 0)&&(D7 == 0)&&(D8 == 0))   motor(35,40);     //0000 1100
	else if((D1 == 0)&&(D2 == 0)&&(D3 == 0)&&(D4 == 1)&&(D5 == 0)&&(D6 == 0)&&(D7 == 0)&&(D8 == 0))   motor(35,40);     //0000 1000
	else if((D1 == 0)&&(D2 == 0)&&(D3 == 0)&&(D4 == 1)&&(D5 == 1)&&(D6 == 0)&&(D7 == 0)&&(D8 == 0))   motor(40,40);     //0001 1000 //正中间位置
	else if((D1 == 0)&&(D2 == 0)&&(D3 == 0)&&(D4 == 0)&&(D5 == 1)&&(D6 == 0)&&(D7 == 0)&&(D8 == 0))   motor(40,35);     //0001 0000
	else if((D1 == 0)&&(D2 == 0)&&(D3 == 0)&&(D4 == 0)&&(D5 == 1)&&(D6 == 1)&&(D7 == 0)&&(D8 == 0))   motor(40,35);     //0011 0000
	else if((D1 == 0)&&(D2 == 0)&&(D3 == 0)&&(D4 == 0)&&(D5 == 0)&&(D6 == 1)&&(D7 == 0)&&(D8 == 0))   motor(40,25);     //0010 0000
	else if((D1 == 0)&&(D2 == 0)&&(D3 == 0)&&(D4 == 0)&&(D5 == 0)&&(D6 == 1)&&(D7 == 1)&&(D8 == 0))   motor(40,20);     //0110 0000
	else if((D1 == 0)&&(D2 == 0)&&(D3 == 0)&&(D4 == 0)&&(D5 == 0)&&(D6 == 0)&&(D7 == 1)&&(D8 == 0))   motor(40,15);     //0100 0000
	else if((D1 == 0)&&(D2 == 0)&&(D3 == 0)&&(D4 == 0)&&(D5 == 0)&&(D6 == 0)&&(D7 == 1)&&(D8 == 1))   motor(50,10);     //1100 0000
	else if((D1 == 0)&&(D2 == 0)&&(D3 == 0)&&(D4 == 0)&&(D5 == 0)&&(D6 == 0)&&(D7 == 0)&&(D8 == 1))   motor(50,0);      //1000 0000
	else motor(20,20);
}

